//Example: STM32F429 reads image from SD Card and show it at VGA display.
//LTDC + SDRAM are used.
// "*.dta" images for SD Card are generated by "BmpCvtST" utility.

//By iliasam

/* Includes ------------------------------------------------------------------*/
#include "main.h"
#include "32f429_sdram.h"
#include "32f429_lcd.h"
#include "string.h"
#include "stdio.h"
#include "stdlib.h"
#include "sd_card_reader.h"

/* Private typedef -----------------------------------------------------------*/
/* Private define ------------------------------------------------------------*/
/* Private macro -------------------------------------------------------------*/
/* Private variables ---------------------------------------------------------*/
static __IO uint32_t uwTimingDelay;
RCC_ClocksTypeDef RCC_Clocks;
char test_string[64];


/* Private function prototypes -----------------------------------------------*/
static void Delay(__IO uint32_t nTime);
void init_gpio(void);

/* Private functions ---------------------------------------------------------*/

int main(void)
{
  uint16_t i;
  //Clock is configured at SetSysClock()
  //SYSCLK is 168MHz

  /* SysTick end of count event each 1ms */
  RCC_GetClocksFreq(&RCC_Clocks);
  SysTick_Config(RCC_Clocks.HCLK_Frequency / 1000);
  
  init_gpio();
  SDRAM_Init();
  Delay(5);
  
  LCD_Init();
  LCD_LayerInit();
  LTDC_Cmd(ENABLE);
  LCD_SetLayer(LCD_BACKGROUND_LAYER);
  
  printf("DISPLAY RUN\r\n");
  
  LCD_Clear(LCD_COLOR_WHITE);
  LCD_SetFont(&Font16x24);
  
  //testing - red bars
  LCD_SetTextColor(LCD_COLOR_RED);
  for (i=0; i< 640; i+= 30)
  {
    LCD_DrawFullRect(i, 0, 15, 480);
  }
  LCD_DisplayStringLine(LINE(1), (uint8_t*)"ILIASAM VGA TEST");
  
  
  //Reading image from SD Card
  int8_t result = mount_file_reader();
  printf("File mount:%d\r\n",result);
  if (result < 0)
  {
    LCD_DisplayStringLine(LINE(2), (uint8_t*)"File read fail");
  }
  else
  {
      char path1[] = "test_image.dta";
      result = read_dta_file_from_card(path1, (uint8_t*)(LCD_FRAME_BUFFER));
  }
  
  GPIO_SetBits(GPIOI, GPIO_Pin_7);//LED
  /* Infinite loop */
  while (1)
  {
    static uint16_t cnt = 0;
    Delay(40);
    sprintf(test_string, "TEST CNT: %d", cnt);
    cnt++;
    
    LCD_SetTextColor(LCD_COLOR_BLACK);
    LCD_DisplayStringLine(LINE(0), (uint8_t*)test_string);
  }
}


void init_gpio(void)
{
  GPIO_InitTypeDef GPIO_InitStructure;
  RCC_AHB1PeriphClockCmd(RCC_AHB1Periph_GPIOA, ENABLE);
  RCC_AHB1PeriphClockCmd(RCC_AHB1Periph_GPIOB, ENABLE);
  RCC_AHB1PeriphClockCmd(RCC_AHB1Periph_GPIOC, ENABLE);
  RCC_AHB1PeriphClockCmd(RCC_AHB1Periph_GPIOD, ENABLE);
  RCC_AHB1PeriphClockCmd(RCC_AHB1Periph_GPIOE, ENABLE);
  RCC_AHB1PeriphClockCmd(RCC_AHB1Periph_GPIOF, ENABLE);
  RCC_AHB1PeriphClockCmd(RCC_AHB1Periph_GPIOG, ENABLE);
  RCC_AHB1PeriphClockCmd(RCC_AHB1Periph_GPIOI, ENABLE);
  
  GPIO_StructInit(&GPIO_InitStructure);
  //LEDS
  GPIO_InitStructure.GPIO_Pin   = GPIO_Pin_6 | GPIO_Pin_7;
  GPIO_InitStructure.GPIO_Mode  = GPIO_Mode_OUT;
  GPIO_InitStructure.GPIO_OType = GPIO_OType_PP;
  GPIO_InitStructure.GPIO_Speed = GPIO_Speed_2MHz;
  GPIO_InitStructure.GPIO_PuPd  = GPIO_PuPd_NOPULL;
  GPIO_Init(GPIOI, &GPIO_InitStructure);
}


void Delay(__IO uint32_t nTime)
{ 
  uwTimingDelay = nTime;

  while(uwTimingDelay != 0);
}

void delay_ms(__IO uint32_t nTime)
{
  Delay(nTime);
}


void TimingDelay_Decrement(void)
{
  if (uwTimingDelay != 0x00)
  { 
    uwTimingDelay--;
  }
}

#ifdef  USE_FULL_ASSERT

void assert_failed(uint8_t* file, uint32_t line)
{ 
  /* User can add his own implementation to report the file name and line number,
     ex: printf("Wrong parameters value: file %s on line %d\r\n", file, line) */

  /* Infinite loop */
  while (1)
  {
  }
}
#endif
